//Default I2C pins for Raspberry Pi Pico
// SDA --> GPIO 4
// SCL --> GPIO 5

#include <Wire.h>
#include <Adafruit_GFX.h>
#include <Adafruit_SSD1306.h>

// only ADC
#define EC11_B 28 // GPIO 26 (orange)
#define EC11_A 27 // GPIO 27 (red)
#define EC11_D 3 // GPIO 3 (brown)

#define DURATION_IDLE 12800 // before screen-saver 
#define SCREEN_WIDTH 128 // OLED display width, in pixels
#define SCREEN_HEIGHT 64 // OLED display height, in pixels
#define FRAME_DELAY 42
#define FRAME_WIDTH 64
#define FRAME_HEIGHT 64
#define FRAME_COUNT (sizeof(frames) / sizeof(frames[0]))
const byte PROGMEM frames[][512] = {
  {0,0,0,0,0,0,0,0,0,0,0,0,0,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0,0},
  {0,0,0,0,0,0,0,0,0,0,0,0,0,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0,0},
  {0,0,0,0,0,0,0,0,0,0,0,0,0,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0,0},
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  {0,0,0,0,0,0,0,0,0,0,0,0,0,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0,0}
};

// Declaration for an SSD1306 display connected to I2C (SDA, SCL pins)
Adafruit_SSD1306 display(SCREEN_WIDTH, SCREEN_HEIGHT, &Wire, -1);
int frame = 0;

#define PBAR_X 14
#define PBAR_Y 38
#define PBAR_WIDTH 10
#define PBAR_LENGTH 100

#define PBAR_OFFSET 2
#define PFIL_X PBAR_X + PBAR_OFFSET
#define PFIL_Y PBAR_Y + PBAR_OFFSET

#define PBAR_FILL PBAR_WIDTH - 4
#define PBAR_VALUE (PBAR_LENGTH-4)/MAX_COUNTER

#define PBAR_RADIUS 12

void setup() {
// CONFIG ::
  // Serial.begin(115200);     // 115200
  Wire.setClock(100000);
  // analogReadResolution(1024); // 10-bit 
  
  pinMode(EC11_A, INPUT);
  pinMode(EC11_B, INPUT);
  pinMode(EC11_D, INPUT_PULLUP);

  if(!display.begin(SSD1306_SWITCHCAPVCC, 0x3C)) { // Address 0x3D for 128x64
    Serial.println(F("SSD1306 allocation failed"));
    for(;;);
  }
  // delay(1000);
  display.clearDisplay();       // clear buffer, indeed.
  display.setTextSize(1);
  display.setTextColor(WHITE);
  display.setCursor(20,30);     // center
  display.println("READY.");
  display.drawPixel(10, 10, SSD1306_WHITE);
  display.display(); 
  // delay(1000);
}
// void loop(){}
#define MIN_COUNTER 0
#define MAX_COUNTER 32
int counter = MAX_COUNTER/2;
int last_counter = counter;
int last_A = 0;
int last_B = 0;
int read_A = 0;
int read_B = 0;
bool was_inc = false;
#define MIN 6   // most of time will be =< 5
#define MAX 50
#define HOLD 50
int avr_counter = 0; 
#define AVR_COUNT 4
unsigned long last_read = 0;
void read_pot(){
  if(millis() - last_read < 16){return;} 
  int avr_A = 0;
  int avr_B = 0;
  for(int i = 0; i < AVR_COUNT; i++){
    read_A = analogRead(A1);
    read_B = analogRead(A2);
    delay(1);
    avr_A += read_A;
    avr_B += read_B;
  }
  read_A = avr_A / AVR_COUNT;
  read_B = avr_B / AVR_COUNT;

  if(read_B != last_B && read_B < MIN && counter < MAX_COUNTER && read_A - last_A > HOLD) { 
    counter+= was_inc ? 0 : 
    // 1;
    (read_A < 60 ? (
    counter+3 < MAX_COUNTER ? 3 : 1) : (read_A < 100 ? (
    counter+2 < MAX_COUNTER ? 2 : 1) : 1)); 
    was_inc = false; 
    } 

  else {
    if(read_A != last_A && read_A < MIN && counter > MIN_COUNTER && read_B - last_B > HOLD) { 
    counter-= !was_inc ? 0 : 
    // 1;
    (read_B < 60 ? (
    counter-3 > 0 ? 3 : 1) : (read_B < 100 ? (
    counter-2 > 0 ? 2 : 1) : 1)); 
    was_inc = true; 
    }
  }
  update_read();
  last_read = millis();
}

void update_read(){
  last_A = read_A;
  last_B = read_B;
}

void test_counter(){
  if(counter < MAX_COUNTER) counter++;
  else counter = 0;
}
// bool anim_test = false;
int mode_values [] = { MAX_COUNTER/2, MAX_COUNTER/2, MAX_COUNTER/2};
const char* modes[] = { "Bass", "Volume", "Tremble" };
const int modes_length = sizeof(modes) / sizeof(modes[0]);
int current_choice = 0;
unsigned long last_click = 0; 
void click_rotary(){
  // clicked Rotary :
  if(millis() - last_click > 128 && digitalRead(EC11_D) == LOW) {
    if(current_choice < modes_length - 1){
      current_choice++;
    } else current_choice = 0;

    // update view:
    counter = mode_values[current_choice];
    last_counter = counter-1;  // update display
    // debounce:
    last_click = millis();
  }
}
unsigned long last_idle = 0;
void loop() {

  read_pot();
  click_rotary();
  // test_counter();

  // only update if there's difference :
  if(last_counter != counter){
      display.clearDisplay();
      display.setCursor(12,24); // center
      display.println(modes[current_choice]);
      display.drawRoundRect(PBAR_X, PBAR_Y, PBAR_LENGTH         , PBAR_WIDTH, PBAR_RADIUS, SSD1306_WHITE);
      display.fillRoundRect(PFIL_X, PFIL_Y, counter * PBAR_VALUE, PBAR_FILL , PBAR_RADIUS, SSD1306_WHITE);
      display.display();
    last_counter = counter;
    mode_values[current_choice] = counter;

    // Serial.print("A | B | counter  :");
    // Serial.print(" " + String(read_A) + " " + String(read_B) + " " + String(counter));
    // Serial.println("");
    last_idle = millis();
    delay(8);
  } 
  else if(millis() - last_idle > DURATION_IDLE){
      display.clearDisplay();
      display.drawBitmap(32, 0, frames[frame], FRAME_WIDTH, FRAME_HEIGHT, 1);
      display.display();
      frame = (frame + 1) % FRAME_COUNT;
  }
  else delay(16); 
}

